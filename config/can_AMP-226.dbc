VERSION ""

NS_ :

BS_:

BU_:

BO_ 321 ready_to_drive: 8 Vector__XXX
 SG_ ready_to_drive : 0|8@1+ (1,0) [0|0] "" Vector__XXX

BO_ 839 task_mode: 8 Vector__XXX
 SG_ task_mode : 0|8@1+ (1,0) [0|0] "" Vector__XXX

BO_ 393 RES: 8 Vector__XXX
 SG_ AS_status : 0|8@1+ (1,0) [0|0] "" Vector__XXX
 SG_ go_signal : 8|8@1+ (1,0) [0|0] "" Vector__XXX

BO_ 1185 datalogger: 8 Vector__XXX
 SG_ steering_angle : 0|32@1- (1,0) [0|0] "" Vector__XXX

SIG_VALTYPE_ 1185 steering_angle : 1;
